/ {
    chosen {
      zmk,battery = &vbatt;
      zmk,matrix_transform = &keymap_transform_1;
    };

    vbatt: vbatt {
        compatible = "zmk,battery-nrf-vddh";
        label = "VBATT";
    };
}
